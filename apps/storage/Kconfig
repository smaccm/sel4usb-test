## apps/storage/Kconfig
```kconfig
#
# Copyright 2014, NICTA
#
# This software may be distributed and modified according to the terms of
# the BSD 2-Clause license. Note that NO WARRANTY is provided.
# See "LICENSE_BSD2.txt" for details.
#
# @TAG(NICTA_BSD)
#

menuconfig APP_STORAGE
    bool "USB STORAGE"
    default y
    depends on HAVE_LIBC
    depends on LIB_SEL4_PLAT_SUPPORT
    depends on LIB_SEL4_VKA
    depends on LIB_SEL4_UTILS
    depends on LIB_UTILS
    depends on LIB_CPIO
    depends on LIB_SEL4
    depends on LIB_ELF
    depends on LIB_USB
    depends on LIB_SEL4_DMA
    help
        USB storage app.
```
